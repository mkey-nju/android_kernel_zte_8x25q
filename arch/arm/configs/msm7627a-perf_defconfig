## arch/arm/configs/msm7627a-perf_defconfig
```kconfig
#//[ECID:0000]ZTE_BSP maxiaoping 20130124 modify for P865F05 basic driver,start.
CONFIG_PROJECT_P865F05=y
#//[ECID:0000]ZTE_BSP maxiaoping 20130124 modify for P865F05 basic driver,end.

#[ECID:000000] ZTEBSP wangbing, for camera soc flash, 20120702 +++
CONFIG_MSM_CAMERA_FLASH_ADP1655=y
CONFIG_ZTE_CAMERA_SOC_FLASH=y
#[ECID:000000] ZTEBSP wangbing, for camera soc flash, 20120702 ---
#ZTEBSP wangminrong add for continus display 
CONFIG_CONTINOUS_LOGO=y
# CONFIG_ARM_PATCH_PHYS_VIRT is not set
CONFIG_EXPERIMENTAL=y
CONFIG_LOCALVERSION="$(KERNEL_LOCAL_VERSION)-perf"
# CONFIG_SWAP is not set
CONFIG_SYSVIPC=y
CONFIG_IKCONFIG=y
CONFIG_IKCONFIG_PROC=y
CONFIG_CGROUPS=y
CONFIG_CGROUP_FREEZER=y
CONFIG_CGROUP_DEVICE=y
CONFIG_CGROUP_CPUACCT=y
CONFIG_RESOURCE_COUNTERS=y
CONFIG_CGROUP_SCHED=y
CONFIG_RT_GROUP_SCHED=y
CONFIG_BLK_DEV_INITRD=y
CONFIG_CC_OPTIMIZE_FOR_SIZE=y
CONFIG_KALLSYMS_ALL=y
CONFIG_ASHMEM=y
CONFIG_EMBEDDED=y
CONFIG_PROFILING=y
CONFIG_OPROFILE=y
CONFIG_KPROBES=y
CONFIG_MODULES=y
CONFIG_MODULE_UNLOAD=y
CONFIG_MODVERSIONS=y
# CONFIG_BLK_DEV_BSG is not set
CONFIG_PARTITION_ADVANCED=y
# CONFIG_IOSCHED_DEADLINE is not set
CONFIG_ARCH_MSM=y
CONFIG_ARCH_MSM7X27=y
CONFIG_ARCH_MSM8625=y
CONFIG_MSM_SOC_REV_A=y
# CONFIG_MACH_MSM7X27_SURF is not set
# CONFIG_MACH_MSM7X27_FFA is not set
# CONFIG_MSM_STACKED_MEMORY is not set
CONFIG_MSM7X00A_USE_DG_TIMER=y
# CONFIG_MSM_FIQ_SUPPORT is not set
CONFIG_MSM_SMD=y
CONFIG_MSM_AMSS_ENHANCE_DEBUG=y
CONFIG_MSM_SMD_PKG4=y
# CONFIG_MSM_SMD_DEBUG is not set
# CONFIG_MSM_RESET_MODEM is not set
# CONFIG_MSM_SMD_NMEA is not set
# CONFIG_MSM_SMD_QMI is not set
CONFIG_MSM_ONCRPCROUTER=y
CONFIG_MSM_IPC_ROUTER=y
# CONFIG_MSM_RPCSERVER_TIME_REMOTE is not set
CONFIG_MSM_RMT_STORAGE_CLIENT=y
# CONFIG_MSM_HW3D is not set
CONFIG_MSM7X27A_AUDIO=y
CONFIG_MSM_DMA_TEST=y
CONFIG_MSM_SLEEP_STATS_DEVICE=y
CONFIG_MSM_SM_EVENT=y
CONFIG_MSM_SM_EVENT_LOG=m
CONFIG_MSM_SLEEP_MONITOR=m
CONFIG_MSM_FAST_BOOT=y
CONFIG_BT_MSM_PINTEST=y
CONFIG_MSM_RPC_VIBRATOR=y
CONFIG_PM8XXX_RPC_VIBRATOR=y
CONFIG_MSM_SPM_V2=y
CONFIG_MSM_MULTIMEDIA_USE_ION=y
CONFIG_MSM_FUSE_INFO_DEBUG=y
CONFIG_MSM_CPR=y
CONFIG_MSM_VP_REGULATOR=y
CONFIG_MSM_FIQ=y
CONFIG_MSM_PBUS=y
CONFIG_ARM_THUMBEE=y
CONFIG_NO_HZ=y
CONFIG_HIGH_RES_TIMERS=y
CONFIG_SMP=y
CONFIG_PREEMPT=y
CONFIG_AEABI=y
CONFIG_HIGHMEM=y
CONFIG_VMALLOC_RESERVE=0xC800000
CONFIG_COMPACTION=y
CONFIG_CP_ACCESS=y
CONFIG_ZBOOT_ROM_TEXT=0x0
CONFIG_ZBOOT_ROM_BSS=0x0
CONFIG_CMDLINE="init=/sbin/init root=/dev/ram rw initrd=0x11000000,16M console=ttyDCC0 mem=88M"
CONFIG_CPU_FREQ=y
CONFIG_CPU_FREQ_STAT_DETAILS=y
CONFIG_CPU_FREQ_GOV_POWERSAVE=y
CONFIG_CPU_FREQ_GOV_USERSPACE=y
CONFIG_CPU_FREQ_GOV_ONDEMAND=y
CONFIG_CPU_FREQ_GOV_INTERACTIVE=y
CONFIG_CPU_FREQ_GOV_CONSERVATIVE=y
CONFIG_VFP=y
CONFIG_NEON=y
# CONFIG_CORE_DUMP_DEFAULT_ELF_HEADERS is not set
CONFIG_WAKELOCK=y
CONFIG_PM_RUNTIME=y
CONFIG_NET=y
CONFIG_PACKET=y
CONFIG_UNIX=y
CONFIG_INET=y
CONFIG_IP_ADVANCED_ROUTER=y
CONFIG_IP_MULTIPLE_TABLES=y
CONFIG_IPV6=y
CONFIG_IPV6_PRIVACY=y
CONFIG_IPV6_ROUTER_PREF=y
CONFIG_IPV6_ROUTE_INFO=y
CONFIG_IPV6_OPTIMISTIC_DAD=y
CONFIG_INET6_AH=y
CONFIG_INET6_ESP=y
CONFIG_INET6_IPCOMP=y
CONFIG_IPV6_MIP6=y
CONFIG_IPV6_TUNNEL=y
CONFIG_IPV6_MULTIPLE_TABLES=y
CONFIG_IPV6_SUBTREES=y
CONFIG_NETFILTER=y
CONFIG_NETFILTER_NETLINK_LOG=y
CONFIG_NF_CONNTRACK=y
CONFIG_NF_CONNTRACK_EVENTS=y
CONFIG_NF_CT_PROTO_DCCP=y
CONFIG_NF_CT_PROTO_SCTP=y
CONFIG_NF_CT_PROTO_UDPLITE=y
CONFIG_NF_CONNTRACK_AMANDA=y
CONFIG_NF_CONNTRACK_FTP=y
CONFIG_NF_CONNTRACK_H323=y
CONFIG_NF_CONNTRACK_IRC=y
CONFIG_NF_CONNTRACK_NETBIOS_NS=y
CONFIG_NF_CONNTRACK_PPTP=y
CONFIG_NF_CONNTRACK_SANE=y
CONFIG_NF_CONNTRACK_SIP=y
CONFIG_NF_CONNTRACK_TFTP=y
CONFIG_NF_CT_NETLINK=y
CONFIG_NETFILTER_TPROXY=y
CONFIG_NETFILTER_XT_TARGET_CLASSIFY=y
CONFIG_NETFILTER_XT_TARGET_CONNMARK=y
CONFIG_NETFILTER_XT_TARGET_LOG=y
CONFIG_NETFILTER_XT_TARGET_MARK=y
CONFIG_NETFILTER_XT_TARGET_NFQUEUE=y
CONFIG_NETFILTER_XT_MATCH_COMMENT=y
CONFIG_NETFILTER_XT_MATCH_CONNLIMIT=y
CONFIG_NETFILTER_XT_MATCH_CONNMARK=y
CONFIG_NETFILTER_XT_MATCH_CONNTRACK=y
CONFIG_NETFILTER_XT_MATCH_HASHLIMIT=y
CONFIG_NETFILTER_XT_MATCH_HELPER=y
CONFIG_NETFILTER_XT_MATCH_IPRANGE=y
CONFIG_NETFILTER_XT_MATCH_LENGTH=y
CONFIG_NETFILTER_XT_MATCH_LIMIT=y
CONFIG_NETFILTER_XT_MATCH_MAC=y
CONFIG_NETFILTER_XT_MATCH_MARK=y
CONFIG_NETFILTER_XT_MATCH_POLICY=y
CONFIG_NETFILTER_XT_MATCH_PKTTYPE=y
CONFIG_NETFILTER_XT_MATCH_QTAGUID=y
CONFIG_NETFILTER_XT_MATCH_QUOTA=y
CONFIG_NETFILTER_XT_MATCH_QUOTA2=y
CONFIG_NETFILTER_XT_MATCH_QUOTA2_LOG=y
CONFIG_NETFILTER_XT_MATCH_SOCKET=y
CONFIG_NETFILTER_XT_MATCH_STATE=y
CONFIG_NETFILTER_XT_MATCH_STATISTIC=y
CONFIG_NETFILTER_XT_MATCH_STRING=y
CONFIG_NETFILTER_XT_MATCH_TIME=y
CONFIG_NETFILTER_XT_MATCH_U32=y
CONFIG_NF_CONNTRACK_IPV4=y
CONFIG_IP_NF_IPTABLES=y
CONFIG_IP_NF_MATCH_AH=y
CONFIG_IP_NF_MATCH_ECN=y
CONFIG_IP_NF_MATCH_TTL=y
CONFIG_IP_NF_FILTER=y
CONFIG_IP_NF_TARGET_REJECT=y
CONFIG_NF_NAT=y
CONFIG_IP_NF_TARGET_MASQUERADE=y
CONFIG_IP_NF_TARGET_NETMAP=y
CONFIG_IP_NF_TARGET_REDIRECT=y
CONFIG_IP_NF_MANGLE=y
CONFIG_IP_NF_RAW=y
CONFIG_IP_NF_ARPTABLES=y
CONFIG_IP_NF_ARPFILTER=y
CONFIG_IP_NF_ARP_MANGLE=y
CONFIG_IP6_NF_IPTABLES=y
CONFIG_IP6_NF_FILTER=y
CONFIG_IP6_NF_MANGLE=y
CONFIG_IP6_NF_RAW=y
CONFIG_BT=y
CONFIG_BT_RFCOMM=y
CONFIG_BT_RFCOMM_TTY=y
CONFIG_BT_BNEP=y
CONFIG_BT_BNEP_MC_FILTER=y
CONFIG_BT_BNEP_PROTO_FILTER=y
CONFIG_BT_HIDP=y
CONFIG_BT_HCIUART=y
CONFIG_BT_HCIUART_H4=y
CONFIG_BT_HCIUART_IBS=y
CONFIG_MSM_BT_POWER=y
CONFIG_CFG80211=m
# CONFIG_CFG80211_WEXT is not set
CONFIG_RFKILL=y
CONFIG_GENLOCK=y
CONFIG_GENLOCK_MISCDEVICE=y
CONFIG_MTD=y
CONFIG_MTD_TESTS=m
CONFIG_MTD_CMDLINE_PARTS=y
CONFIG_MTD_CHAR=y
CONFIG_MTD_BLOCK=y
CONFIG_BLK_DEV_LOOP=y
CONFIG_MISC_DEVICES=y
#CONFIG_SENSORS_AK8975 is not set
#CONFIG_MPU_SENSORS_TIMERIRQ is not set
#CONFIG_MPU_SENSORS_BMA250 is not set
#CONFIG_MPU_SENSORS_MMC328X is not set
CONFIG_SCSI=y
#[ECID:000000] ZTEBSP wanghaifei start 20120330, for sensor
#CONFIG_TI_ST_GYRO_L3G4200D=y
CONFIG_TI_ST_ACCEL_LIS3DH=y
#CONFIG_TI_ST_COMPASS_AK8963=y
CONFIG_ZTE_SENSORS_KXTF9=y
#[ECID:000000] ZTEBSP wanghaifei end 20120330, for sensor
CONFIG_SCSI_TGT=y
CONFIG_BLK_DEV_SD=y
CONFIG_CHR_DEV_SG=y
CONFIG_CHR_DEV_SCH=y
CONFIG_SCSI_MULTI_LUN=y
CONFIG_SCSI_CONSTANTS=y
CONFIG_SCSI_LOGGING=y
CONFIG_SCSI_SCAN_ASYNC=y
CONFIG_MD=y
CONFIG_BLK_DEV_DM=y
CONFIG_DM_CRYPT=y
CONFIG_NETDEVICES=y
CONFIG_TUN=y
CONFIG_SMC91X=y
CONFIG_SMSC911X=y
CONFIG_LIBRA_SDIOIF=m
# CONFIG_INPUT_MOUSEDEV is not set
CONFIG_INPUT_EVDEV=y
CONFIG_INPUT_EVBUG=m
# CONFIG_INPUT_KEYBOARD is not set
# CONFIG_INPUT_MOUSE is not set
CONFIG_INPUT_TOUCHSCREEN=y
#[ECID:000000] ZTEBSP zhangbo disable ATMEL config, start
#CONFIG_TOUCHSCREEN_ATMEL_MAXTOUCH=y
#CONFIG_TOUCHSCREEN_ATMEL_MXT=y
CONFIG_TOUCHSCREEN_SYNAPTICS_RMI4_I2C=y
#CONFIG_TOUCHSCREEN_FT5X06 is not set
CONFIG_TOUCHSCREEN_VIRTUAL_KEYS=y
CONFIG_TOUCHSCREEN_SYNAPTICS_3K=y
CONFIG_TOUCHSCREEN_FOCALTECH_NEW=y
CONFIG_TOUCHSCREEN_SYNAPTICS_I2C_RMI=y
CONFIG_FTS_USB_NOTIFY=y
CONFIG_SUPPORT_FTS_CTP_UPG=y
CONFIG_INPUT_MISC=y
CONFIG_INPUT_UINPUT=y
CONFIG_INPUT_GPIO=y
CONFIG_INPUT_LTR502 is not set
CONFIG_INPUT_LTR558 is not set
CONFIG_BOSCH_BMA250 is not set
CONFIG_INPUT_ISL29028 is not set
CONFIG_INPUT_LIS3DH= is not set
CONFIG_AVAGO_APDS990X is not set
CONFIG_SENSORS_TMD2771X is not set
#[ECID:000000] ZTEBSP wanghaifei start 20120330, for light&&proximity sensor
CONFIG_INPUT_LIGHTSENSOR_TAOS=y
CONFIG_INPUT_LIGHTSENSOR_LTR558=y
#[ECID:000000] ZTEBSP wanghaifei end 20120330, for light&&proximity sensor
# CONFIG_SERIO is not set
# CONFIG_LEGACY_PTYS is not set
CONFIG_SERIAL_MSM=y
#ZTEBSP yaotierui
#CONFIG_SERIAL_MSM_CONSOLE is not set
CONFIG_SERIAL_MSM_HS=y
CONFIG_SERIAL_MSM_HSL=y
CONFIG_SERIAL_MSM_HSL_CONSOLE=y
# CONFIG_SERIAL_MSM_CLOCK_CONTROL is not set
CONFIG_DIAG_CHAR=y
# CONFIG_HW_RANDOM is not set
CONFIG_I2C=y
CONFIG_I2C_CHARDEV=y
CONFIG_I2C_GPIO=y
# CONFIG_I2C_MSM is not set
CONFIG_I2C_QUP=y
CONFIG_DEBUG_GPIO=y
CONFIG_GPIO_SYSFS=y
CONFIG_GPIO_SX150X=y
CONFIG_POWER_SUPPLY=y
CONFIG_BATTERY_MSM=y
CONFIG_SENSORS_MSM_ADC=y
CONFIG_MARIMBA_CORE=y
CONFIG_REGULATOR_FAN53555=y
CONFIG_REGULATOR_ONSEMI_NCP6335D=y

CONFIG_REGULATOR_MSM_GPIO=y
CONFIG_MEDIA_SUPPORT=y
CONFIG_MEDIA_CONTROLLER=y
CONFIG_VIDEO_DEV=y
CONFIG_VIDEO_V4L2_SUBDEV_API=y
# CONFIG_RC_CORE is not set
# CONFIG_MEDIA_TUNER_CUSTOMISE is not set
CONFIG_VIDEOBUF2_MSM_MEM=y
CONFIG_V4L_PLATFORM_DRIVERS=y
CONFIG_MSM_CAMERA_V4L2=y
#ZTEBSP zhangzhao 2012-7-3 modified start
#CONFIG_OV5647 is not set
#CONFIG_OV5647_TRULY_CM6868 is not set
#CONFIG_OV5648_TRULY_CM8352 is not set
CONFIG_AD5046_ACT=y
#CONFIG_WEBCAM_OV9726=y
#CONFIG_MT9E013=y
#CONFIG_S5K4E1=y
CONFIG_DW9712_ACT=y
#ZTEBSP zhangzhao add for OV5640,2012.04.23 
#CONFIG_OV5640=y
#CONFIG_JT8EV5=y
#ZTEBSP zhangzhao 2012-7-3 modified end
CONFIG_HI542=y #ZTEBSP yuxin add for P865F03 use hi542,2012.11.07
CONFIG_SP0A28=y #ZTEBSP yuxin add for P865F03 use sp0a28,2012.11.07
#CONFIG_MSM_CAMERA_FLASH_SC628A is not set
#ZTEBSP zhangzhao add for OV5640,2012.04.23 --
#wangjianping 20121031 added camera flash LM3642
CONFIG_FLASH_LM3642=y
#CONFIG_OV8825=y
CONFIG_MSM_CAMERA_SENSOR=y
CONFIG_MSM_ACTUATOR=y
#CONFIG_OV7692 is not set
# CONFIG_OV7695 is not set
#CONFIG_OV7695_RAW is not set
#CONFIG_MT9V115 is not set
CONFIG_RADIO_TAVARUA=y
CONFIG_ION=y
CONFIG_ION_MSM=y
CONFIG_MSM_KGSL=y
CONFIG_MSM_KGSL_DISABLE_SHADOW_WRITES=y
CONFIG_FB=y
CONFIG_FB_MSM=y
# CONFIG_FB_MSM_BACKLIGHT is not set
#ZTEBSP  yaotierui
CONFIG_FB_MSM_LOGO=y
CONFIG_FB_MSM_TRIPLE_BUFFER=y
CONFIG_FB_MSM_MDP30=y
CONFIG_FB_MSM_MDP303=y
#ZTEBSP yaotierui for lcd
CONFIG_FB_MSM_GPIO=y
CONFIG_FB_MSM_MIPI_LEAD_VIDEO_WVGA_PT_PANEL=y
#CONFIG_FB_MSM_LCDC_TRULY_HVGA_IPS3P2335_PT_PANEL is not set
#CONFIG_FB_MSM_MIPI_PANEL_DETECT is not set

#//[ECID:0000]ZTE_BSP maxiaoping 20120427 for lcd backlight driver,start.
CONFIG_TPS61165_LCD_BL =y
#//[ECID:0000]ZTE_BSP maxiaoping 20120427 for lcd backlight driver,end.

CONFIG_BACKLIGHT_LCD_SUPPORT=y
CONFIG_BACKLIGHT_CLASS_DEVICE=y
CONFIG_SOUND=y
CONFIG_SND=y
CONFIG_SND_SOC=y
CONFIG_SND_MSM_SOC=y
CONFIG_HID_APPLE=y
CONFIG_HID_MAGICMOUSE=y
CONFIG_HID_MICROSOFT=y
CONFIG_USB=y
CONFIG_USB_ANNOUNCE_NEW_DEVICES=y
CONFIG_USB_SUSPEND=y
CONFIG_USB_EHCI_HCD=y
CONFIG_USB_EHCI_EHSET=y
CONFIG_USB_EHCI_ROOT_HUB_TT=y
# CONFIG_USB_EHCI_TT_NEWSCHED is not set
CONFIG_USB_EHCI_MSM_72K=y
CONFIG_USB_ACM=y
CONFIG_USB_STORAGE=y
CONFIG_USB_STORAGE_DATAFAB=y
CONFIG_USB_STORAGE_FREECOM=y
CONFIG_USB_STORAGE_ISD200=y
CONFIG_USB_STORAGE_USBAT=y
CONFIG_USB_STORAGE_SDDR09=y
CONFIG_USB_STORAGE_SDDR55=y
CONFIG_USB_STORAGE_JUMPSHOT=y
CONFIG_USB_STORAGE_ALAUDA=y
CONFIG_USB_STORAGE_ONETOUCH=y
CONFIG_USB_STORAGE_KARMA=y
CONFIG_USB_STORAGE_CYPRESS_ATACB=y
CONFIG_USB_EHSET_TEST_FIXTURE=y
CONFIG_USB_GADGET=y
CONFIG_USB_MSM_72K=y
CONFIG_USB_G_ANDROID=y
CONFIG_RMNET_SMD_CTL_CHANNEL="DATA40_CNTL"
CONFIG_RMNET_SMD_DATA_CHANNEL="DATA40"
CONFIG_MMC=y
CONFIG_MMC_PERF_PROFILING=y
CONFIG_MMC_UNSAFE_RESUME=y
CONFIG_MMC_CLKGATE=y
CONFIG_MMC_PARANOID_SD_INIT=y
CONFIG_MMC_BLOCK_MINORS=32
# CONFIG_MMC_BLOCK_BOUNCE is not set
CONFIG_MMC_TEST=m
CONFIG_MMC_MSM=y
CONFIG_MMC_MSM_SDC3_SUPPORT=y
CONFIG_MMC_MSM_SDC3_8_BIT_SUPPORT=y

#//[ECID:0000]ZTE_BSP maxiaoping 20130124 modify leds feature for 8x25qrd,start.
CONFIG_LEDS_MSM_PDM=y
CONFIG_LEDS_MSM_PMIC=y
CONFIG_LEDS_KEYBOARD_GPIO=y
#CONFIG_LEDS_MSM_TRICOLOR is not set
CONFIG_LEDS_GPIO=y
#CONFIG_GPIO_CTRL_LED=y
#CONFIG_LEDS_PMIC_MPP is not set
#CONFIG_LEDS_KEYBOARD_PM_MPP is not set
#CONFIG_LEDS_PMIC8029 is not set
#CONFIG_LEDS_MSM_TRICOLOR is not set
#//[ECID:0000]ZTE_BSP maxiaoping 20130124 modify leds feature for 8x25qrd,end.

CONFIG_SWITCH=y
CONFIG_SWITCH_GPIO=y
CONFIG_RTC_CLASS=y
CONFIG_STAGING=y
CONFIG_ANDROID=y
CONFIG_ANDROID_BINDER_IPC=y
CONFIG_ANDROID_LOGGER=y
CONFIG_ANDROID_LOW_MEMORY_KILLER=y
CONFIG_ANDROID_LOW_MEMORY_KILLER_AUTODETECT_OOM_ADJ_VALUES=y
CONFIG_EXT2_FS=y
CONFIG_EXT2_FS_XATTR=y
CONFIG_EXT3_FS=y
# CONFIG_EXT3_DEFAULTS_TO_ORDERED is not set
CONFIG_EXT4_FS=y
CONFIG_FUSE_FS=y
CONFIG_VFAT_FS=y
CONFIG_TMPFS=y
CONFIG_YAFFS_FS=y
CONFIG_YAFFS_DISABLE_TAGS_ECC=y
CONFIG_NLS_CODEPAGE_437=y
CONFIG_NLS_ASCII=y
CONFIG_NLS_ISO8859_1=y
CONFIG_PRINTK_TIME=y
CONFIG_PRINTK_RTC_TIME=y
CONFIG_PRINTK_CPU_ID=y
CONFIG_MAGIC_SYSRQ=y
CONFIG_DEBUG_SHIRQ=y
# CONFIG_DEBUG_PREEMPT is not set
# CONFIG_SCHED_DEBUG is not set
CONFIG_TIMER_STATS=y
CONFIG_DEBUG_SPINLOCK=y
CONFIG_DEBUG_STACK_USAGE=y
CONFIG_DEBUG_INFO=y
CONFIG_ENABLE_DEFAULT_TRACERS=y
CONFIG_DYNAMIC_DEBUG=y
CONFIG_DEBUG_USER=y
CONFIG_CRYPTO_TWOFISH=y
CONFIG_CRC_CCITT=y
# Add 20120823 TS-FMC-V2 start
CONFIG_PPP=y
CONFIG_PPP_ASYNC=y
CONFIG_PPP_DEFLATE=y
CONFIG_PPP_BSDCOMP=y
# Add 20120823 TS-FMC-V2 end

#[ECID:000000] ZteSettings zhengcz start 20130117, for VPN connect
CONFIG_PPP=y
CONFIG_PPP_MULTILINK=y
CONFIG_PPP_FILTER=y
CONFIG_PPP_ASYNC=y
CONFIG_PPP_SYNC_TTY=y
CONFIG_PPP_DEFLATE=y
CONFIG_PPP_BSDCOMP=y
CONFIG_PPP_MPPE=y
CONFIG_PPPOE=y
CONFIG_PPTP=y
CONFIG_PPPOLAC=y
CONFIG_PPPOPNS=y
CONFIG_SLIP=y
CONFIG_SLIP_COMPRESSED=y
CONFIG_INPUT_POLLDEV=y
CONFIG_NET_KEY=y
CONFIG_INET_ESP=y
CONFIG_INET_AH=y
CONFIG_INET_IPCOMP=y
CONFIG_INET_TUNNEL=y
CONFIG_XFRM_USER=y
CONFIG_NET_KEY_MIGRATE=y
CONFIG_XFRM_MIGRATE=y
CONFIG_INET_XFRM_TUNNEL=y
CONFIG_INET_XFRM_MODE_TRANSPORT=y
CONFIG_INET_XFRM_MODE_TUNNEL=y
CONFIG_INET_XFRM_MODE_BEET=y
#[ECID:000000] ZteSettings zhengcz end 20130117, for VPN connect

#//[ECID:0000] ZTEBSP maxiaoping 20120521 for hardware board id,start.
CONFIG_HW_BOARD_ID=y
CONFIG_HW_BOARD_ID_USE_THREE_GPIOS=y
#//[ECID:0000] ZTEBSP maxiaoping 20120521 for hardware board id,end.
#zte-modify, yanxiangyang, 2012.6.2, add PPPOE support, begin
#zte-modify,zhangbo ,20120717,add for ram_console,begin
CONFIG_ANDROID_RAM_CONSOLE=y
CONFIG_ANDROID_RAM_CONSOLE_ENABLE_VERBOSE=y
CONFIG_ANDROID_RAM_CONSOLE_ERROR_CORRECTION=y
CONFIG_ANDROID_RAM_CONSOLE_ERROR_CORRECTION_DATA_SIZE=128
CONFIG_ANDROID_RAM_CONSOLE_ERROR_CORRECTION_ECC_SIZE=16
CONFIG_ANDROID_RAM_CONSOLE_ERROR_CORRECTION_SYMBOL_SIZE=8
CONFIG_ANDROID_RAM_CONSOLE_ERROR_CORRECTION_POLYNOMIAL=0x11d
#zte-modify, zhangbo, 2012.12.11, ram console +++
CONFIG_ANDROID_PERSISTENT_RAM=y
#zte-modify, zhangbo, 2012.12.11, ram console ---
#zte-modify,zhangbo ,20120717,add for ram_console,end

#ZTEBSP weiguohua add it for loop back func start 20120612
CONFIG_ZTE_AUDIO_LOOP_BACK_FUNC=y
#ZTEBSP weiguohua add it for loop back func end 20120612
#ZTEBSP zhangqi add it for cabc func start 20120702
CONFIG_BACKLIGHT_CABC=y
#ZTEBSP zhangqi add it for cabc func end 20120702
#ZTEBSP zhangjing add it for usb at start 20130106
CONFIG_USB_AT=y
#ZTEBSP zhangjing add it for usb at end 20130106
#[ECID:000000] ZTEBSP doumingming add for high voltage battery, start
CONFIG_HIGH_VOLTAGE_BATTERY=y
#[ECID:000000] ZTEBSP doumingming add for high voltage battery, end

#ZTEBSP maxiaoping 20130325 for MSM8625Q CDMA time sync from MDM side,start.
CONFIG_ZTE_MDM_TIME_SYNC=y
#ZTEBSP maxiaoping 20130325 for MSM8625Q CDMA time sync from MDM side,end.
```

## drivers/misc/akm/Kconfig
```kconfig
#[ECID:000000] ZTEBSP wanghaifei 20120405 start, for compile
menu "AKM Sensors Support"

choice
    prompt "Compass Type"
    depends on I2C
    optional

config AKM_SENSORS_AK8962
    bool "AKM ak8962"
    help
      This enables support for the AKM ak8962 compass

endchoice

choice
    prompt "Accelerometer Type"
    depends on I2C && AKM_SENSORS_AK8962
    optional

config AKM_SENSORS_KXTF9
    bool "Kionix KXTF9"
    select INPUT_POLLDEV
    help
      This enables support for the Kionix KXFT9 accelerometer

config AKM_SENSORS_MMA845X
    bool "Freescale mma8451/8452/8453"
    help
      This enables support for the Freescale mma8451/8452/8453 accelerometer
endchoice

endmenu
#[ECID:000000] ZTEBSP wanghaifei 20120405 end, for compile
```
